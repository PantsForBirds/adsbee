# CC1314R10 register map
File version: 1.0
CPU: CM33 1.0, other endian, MPU, FPU, 3 interrupt priority bits
Registers are 32-bit, read-write, reset 0x0 unless marked. A register's access mark holds for its fields unless they carry their own. Offsets are from the block's base; [hi:lo] are bit positions; {n}, {i} and the like mark numbered series; 'fields as' and 'values as' point back to an identical list.

## EVENT (part 1 of 2) — Event Fabric Component Definition
Base 0x40083000
0x00 CPUIRQSEL0 reset 0x4 — Output Selection for CPU Interrupt 0
  [7:0] EV ro — [7:0] Read only selection value
    4=AON_GPIO_EDGE (Edge detect event from IOC. Configureded by the IOC:IOCFGn.EDGE_IRQ_EN and IOC:IOCFGn.EDGE_DET settings)
0x04 CPUIRQSEL1 reset 0x9 — Output Selection for CPU Interrupt 1
  [7:0] EV ro — [7:0] Read only selection value
    9=I2C_IRQ (Interrupt event from I2C)
0x08 CPUIRQSEL2 reset 0x1E — Output Selection for CPU Interrupt 2
  [7:0] EV ro — [7:0] Read only selection value
    30=RFC_CPE_1 (Combined Interrupt for CPE Generated events. Corresponding flags are here RFC_DBELL:RFCPEIFG. Only interrupts selected with CPE1 in RFC_DBELL:RFCPEIFG can trigger a RFC_CPE_1 event)
0x0C CPUIRQSEL3 reset 0x1F — Output Selection for CPU Interrupt 3
  [7:0] EV ro — [7:0] Read only selection value
    31=PKA_IRQ (PKA Interrupt event)
0x10 CPUIRQSEL4 reset 0x7 — Output Selection for CPU Interrupt 4
  [7:0] EV ro — [7:0] Read only selection value
    7=AON_RTC_COMB (Event from AON_RTC, controlled by the AON_RTC:CTL.COMB_EV_MASK setting)
0x14 CPUIRQSEL5 reset 0x24 — Output Selection for CPU Interrupt 5
  [7:0] EV ro — [7:0] Read only selection value
    36=UART0_COMB (UART0 combined interrupt, interrupt flags are found here UART0:MIS)
0x18 CPUIRQSEL6 reset 0x1C — Output Selection for CPU Interrupt 6
  [7:0] EV ro — [7:0] Read only selection value
    28=AUX_SWEV0 (AUX software event 0, triggered by AUX_EVCTL:SWEVSET.SWEV0, also available as AUX_EVENT0 AON wake up event. MCU domain wakeup control AON_EVENT:MCUWUSEL)
0x1C CPUIRQSEL7 reset 0x22 — Output Selection for CPU Interrupt 7
  [7:0] EV ro — [7:0] Read only selection value
    34=SPI0_COMB (SPI0 combined interrupt, interrupt flags are found here SPI0:MIS)
0x20 CPUIRQSEL8 reset 0x23 — Output Selection for CPU Interrupt 8
  [7:0] EV ro — [7:0] Read only selection value
    35=SPI1_COMB (SPI1 combined interrupt, interrupt flags are found here SPI1:MIS)
0x24 CPUIRQSEL9 reset 0x1B — Output Selection for CPU Interrupt 9
  [7:0] EV ro — [7:0] Read only selection value
    27=RFC_CPE_0 (Combined Interrupt for CPE Generated events. Corresponding flags are here RFC_DBELL:RFCPEIFG. Only interrupts selected with CPE0 in RFC_DBELL:RFCPEIFG can trigger a RFC_CPE_0 event)
0x28 CPUIRQSEL10 reset 0x1A — Output Selection for CPU Interrupt 10
  [7:0] EV ro — [7:0] Read only selection value
    26=RFC_HW_COMB (Combined RFC hardware interrupt, corresponding flag is here RFC_DBELL:RFHWIFG)
0x2C CPUIRQSEL11 reset 0x19 — Output Selection for CPU Interrupt 11
  [7:0] EV ro — [7:0] Read only selection value
    25=RFC_CMD_ACK (RFC Doorbell Command Acknowledgement Interrupt, equvialent to RFC_DBELL:RFACKIFG.ACKFLAG)
0x30 CPUIRQSEL12 reset 0x8 — Output Selection for CPU Interrupt 12
  [7:0] EV ro — [7:0] Read only selection value
    8=I2S_IRQ (Interrupt event from I2S)
0x34 CPUIRQSEL13 reset 0x1D — Output Selection for CPU Interrupt 13
  [7:0] EV ro — [7:0] Read only selection value
    29=AUX_SWEV1 (AUX software event 1, triggered by AUX_EVCTL:SWEVSET.SWEV1, also available as AUX_EVENT2 AON wake up event. MCU domain wakeup control AON_EVENT:MCUWUSEL)
0x38 CPUIRQSEL14 reset 0x18 — Output Selection for CPU Interrupt 14
  [7:0] EV ro — [7:0] Read only selection value
    24=WDT_IRQ (Watchdog interrupt event, controlled by WDT:CTL.INTEN)
0x3C CPUIRQSEL15 reset 0x10 — Output Selection for CPU Interrupt 15
  [7:0] EV ro — [7:0] Read only selection value
    16=GPT0A (GPT0A interrupt event, controlled by GPT0:TAMR)
0x40 CPUIRQSEL16 reset 0x11 — Output Selection for CPU Interrupt 16
  [7:0] EV ro — [7:0] Read only selection value
    17=GPT0B (GPT0B interrupt event, controlled by GPT0:TBMR)
0x44 CPUIRQSEL17 reset 0x12 — Output Selection for CPU Interrupt 17
  [7:0] EV ro — [7:0] Read only selection value
    18=GPT1A (GPT1A interrupt event, controlled by GPT1:TAMR)
0x48 CPUIRQSEL18 reset 0x13 — Output Selection for CPU Interrupt 18
  [7:0] EV ro — [7:0] Read only selection value
    19=GPT1B (GPT1B interrupt event, controlled by GPT1:TBMR)
0x4C CPUIRQSEL19 reset 0xC — Output Selection for CPU Interrupt 19
  [7:0] EV ro — [7:0] Read only selection value
    12=GPT2A (GPT2A interrupt event, controlled by GPT2:TAMR)
0x50 CPUIRQSEL20 reset 0xD — Output Selection for CPU Interrupt 20
  [7:0] EV ro — [7:0] Read only selection value
    13=GPT2B (GPT2B interrupt event, controlled by GPT2:TBMR)
0x54 CPUIRQSEL21 reset 0xE — Output Selection for CPU Interrupt 21
  [7:0] EV ro — [7:0] Read only selection value
    14=GPT3A (GPT3A interrupt event, controlled by GPT3:TAMR)
0x58 CPUIRQSEL22 reset 0xF — Output Selection for CPU Interrupt 22
  [7:0] EV ro — [7:0] Read only selection value
    15=GPT3B (GPT3B interrupt event, controlled by GPT3:TBMR)
0x5C CPUIRQSEL23 reset 0x5D — Output Selection for CPU Interrupt 23
  [7:0] EV ro — [7:0] Read only selection value
    93=CRYPTO_RESULT_AVAIL_IRQ (CRYPTO result available interupt event, the corresponding flag is found here CRYPTO:IRQSTAT.RESULT_AVAIL. Controlled by CRYPTO:IRQSTAT.RESULT_AVAIL)
0x60 CPUIRQSEL24 reset 0x27 — Output Selection for CPU Interrupt 24
  [7:0] EV ro — [7:0] Read only selection value
    39=DMA_DONE_COMB (Combined DMA done, corresponding flags are here UDMA0:REQDONE)
0x64 CPUIRQSEL25 reset 0x26 — Output Selection for CPU Interrupt 25
  [7:0] EV ro — [7:0] Read only selection value
    38=DMA_ERR (DMA bus error, corresponds to UDMA0:ERROR.STATUS)
0x68 CPUIRQSEL26 reset 0x15 — Output Selection for CPU Interrupt 26
  [7:0] EV ro — [7:0] Read only selection value
    21=FLASH (FLASH controller error event, the status flags are FLASH:FEDACSTAT.FSM_DONE and FLASH:FEDACSTAT.RVF_INT)
0x6C CPUIRQSEL27 reset 0x64 — Output Selection for CPU Interrupt 27
  [7:0] EV ro — [7:0] Read only selection value
    100=SWEV0 (Software event 0, triggered by SWEV.SWEV0)
0x70 CPUIRQSEL28 reset 0xB — Output Selection for CPU Interrupt 28
  [7:0] EV ro — [7:0] Read only selection value
    11=AUX_COMB (AUX combined event, the corresponding flag register is here AUX_EVCTL:EVTOMCUFLAGS)
0x74 CPUIRQSEL29 reset 0x1 — Output Selection for CPU Interrupt 29
  [7:0] EV ro — [7:0] Read only selection value
    1=AON_PROG0 (AON programmable event 0. Event selected by AON_EVENT MCU event selector, AON_EVENT:EVTOMCUSEL.AON_PROG0_EV)
0x78 CPUIRQSEL30 — Output Selection for CPU Interrupt 30
  [7:0] EV — [7:0] Read/write selection value Writing any other value than values defined by a ENUM may result in undefined behavior.
    121=ALWAYS_ACTIVE (Always asserted); 119=AON_RTC_UPD (RTC periodic event controlled by AON_RTC:CTL.RTC_UPD_EN); 114=AUX_OBSMUX0 (Loopback of OBSMUX0 through AUX, corresponds to AUX_EVCTL:EVTOMCUFLAGS.MCU_OBSMUX0); 113=AUX_ADC_FIFO_ALMOST_FULL (AUX ADC FIFO watermark event, corresponds to AUX_EVCTL:EVTOMCUFLAGS.AUX_ADC_FIFO_ALMOST_FULL); 112=AUX_ADC_DONE (AUX ADC done, corresponds to AUX_EVCTL:EVTOMCUFLAGS.AUX_ADC_DONE); 111=AUX_SMPH_AUTOTAKE_DONE (Autotake event from AUX semaphore, configured by AUX_SMPH:AUTOTAKE); 110=AUX_TIMER1_EV (AUX timer 1 event, corresponds to AUX_EVCTL:EVTOMCUFLAGS.AUX_TIMER1_EV); 109=AUX_TIMER0_EV (AUX timer 0 event, corresponds to AUX_EVCTL:EVTOMCUFLAGS.AUX_TIMER0_EV); 108=AUX_TDC_DONE (AUX TDC measurement done event, corresponds to the flag AUX_EVCTL:EVTOMCUFLAGS.AUX_TDC_DONE and the AUX_TDC status AUX_TDC:STAT.DONE); 107=AUX_COMPB (AUX Compare B event, corresponds to AUX_EVCTL:EVTOMCUFLAGS.AUX_COMPB); 105=AUX_AON_WU_EV (AON wakeup event, the corresponding flag is here AUX_EVCTL:EVTOMCUFLAGS.AUX_WU_EV); 94=CRYPTO_DMA_DONE_IRQ (CRYPTO DMA input done event, the correspondingg flag is CRYPTO:IRQSTAT.DMA_IN_DONE. Controlled by CRYPTO:IRQEN.DMA_IN_DONE); 60=AUX_TIMER2_PULSE (AUX Timer2 pulse, corresponding to flag AUX_EVCTL:EVTOMCUFLAGS.AUX_TIMER2_PULSE); {v}=AUX_TIMER2_EV{v-56} (AUX Timer2 event {v-56}, corresponding to flag AUX_EVCTL:EVTOMCUFLAGS.AUX_TIMER2_EV{v-56}) (v=56..59); 22=DMA_CH18_DONE (DMA done for software tiggered UDMA channel 18, see UDMA0:SOFTREQ); 20=DMA_CH0_DONE (DMA done for software tiggered UDMA channel 0, see UDMA0:SOFTREQ); 10=AON_AUX_SWEV0 (AUX Software event 0, AUX_EVCTL:SWEVSET.SWEV0); 8=I2S_IRQ (Interrupt event from I2S); 3=AON_PROG2 (AON programmable event 2. Event selected by AON_EVENT MCU event selector, AON_EVENT:EVTOMCUSEL.AON_PROG2_EV); 2=AON_PROG1 (AON programmable event 1. Event selected by AON_EVENT MCU event selector, AON_EVENT:EVTOMCUSEL.AON_PROG1_EV); 0=NONE (Always inactive)
0x7C CPUIRQSEL31 reset 0x6A — Output Selection for CPU Interrupt 31
  [7:0] EV ro — [7:0] Read only selection value
    106=AUX_COMPA (AUX Compare A event, corresponds to AUX_EVCTL:EVTOMCUFLAGS.AUX_COMPA)
0x80 CPUIRQSEL32 reset 0x73 — Output Selection for CPU Interrupt 32
  [7:0] EV ro — [7:0] Read only selection value
    115=AUX_ADC_IRQ (AUX ADC interrupt event, corresponds to AUX_EVCTL:EVTOMCUFLAGS.AUX_ADC_IRQ. Status flags are found here AUX_EVCTL:EVTOMCUFLAGS)
0x84 CPUIRQSEL33 reset 0x68 — Output Selection for CPU Interrupt 33
  [7:0] EV ro — [7:0] Read only selection value
    104=TRNG_IRQ (TRNG Interrupt event, controlled by TRNG:IRQEN.EN)
0x88 CPUIRQSEL34 reset 0x6 — Output Selection for CPU Interrupt 34
  [7:0] EV ro — [7:0] Read only selection value
    6=OSC_COMB (Combined event from Oscillator control)
0x8C CPUIRQSEL35 reset 0x38 — Output Selection for CPU Interrupt 35
  [7:0] EV ro — [7:0] Read only selection value
    56=AUX_TIMER2_EV0 (AUX Timer2 event 0, corresponding to flag AUX_EVCTL:EVTOMCUFLAGS.AUX_TIMER2_EV0)
0x90 CPUIRQSEL36 reset 0x25 — Output Selection for CPU Interrupt 36
  [7:0] EV ro — [7:0] Read only selection value
    37=UART1_COMB (UART1 combined interrupt, interrupt flags are found here UART1:MIS)
0x94 CPUIRQSEL37 reset 0x5 — Output Selection for CPU Interrupt 37
  [7:0] EV ro — [7:0] Read only selection value
    5=BATMON_COMB (Combined event from battery monitor)
0x98 CPUIRQSEL38 reset 0x7A — Output Selection for CPU Interrupt 38
  [7:0] EV ro — [7:0] Read only selection value
    122=SPI2_COMB (SPI2 combined interrupt, interrupt flags are found here SPI2:MIS)
0x9C CPUIRQSEL39 reset 0x7B — Output Selection for CPU Interrupt 39
  [7:0] EV ro — [7:0] Read only selection value
    123=SPI3_COMB (SPI3 combined interrupt, interrupt flags are found here SPI3:MIS)
0xA0 CPUIRQSEL40 reset 0x7C — Output Selection for CPU Interrupt 40
  [7:0] EV ro — [7:0] Read only selection value
    124=UART2_COMB (UART2 combined interrupt, interrupt flags are found here UART2:MIS)
0xA4 CPUIRQSEL41 reset 0x7D — Output Selection for CPU Interrupt 41
  [7:0] EV ro — [7:0] Read only selection value
    125=UART3_COMB (UART3 combined interrupt, interrupt flags are found here UART3:MIS)
0xA8 CPUIRQSEL42 reset 0x7E — Output Selection for CPU Interrupt 42
  [7:0] EV ro — [7:0] Read only selection value
    126=I2C1_IRQ (Interrupt event from I2C1)
0x100 RFCSEL0 reset 0x3D — Output Selection for RFC Event 0
  [7:0] EV ro — [7:0] Read only selection value
    61=GPT0A_CMP (GPT0A compare event. Configured by GPT0:TAMR.TCACT)
0x104 RFCSEL1 reset 0x3E — Output Selection for RFC Event 1
  [7:0] EV ro — [7:0] Read only selection value
    62=GPT0B_CMP (GPT0B compare event. Configured by GPT0:TBMR.TCACT)
0x108 RFCSEL2 reset 0x3F — Output Selection for RFC Event 2
  [7:0] EV ro — [7:0] Read only selection value
    63=GPT1A_CMP (GPT1A compare event. Configured by GPT1:TAMR.TCACT)
0x10C RFCSEL3 reset 0x40 — Output Selection for RFC Event 3
  [7:0] EV ro — [7:0] Read only selection value
    64=GPT1B_CMP (GPT1B compare event. Configured by GPT1:TBMR.TCACT)
0x110 RFCSEL4 reset 0x41 — Output Selection for RFC Event 4
  [7:0] EV ro — [7:0] Read only selection value
    65=GPT2A_CMP (GPT2A compare event. Configured by GPT2:TAMR.TCACT)
0x114 RFCSEL5 reset 0x42 — Output Selection for RFC Event 5
  [7:0] EV ro — [7:0] Read only selection value
    66=GPT2B_CMP (GPT2B compare event. Configured by GPT2:TBMR.TCACT)
0x118 RFCSEL6 reset 0x43 — Output Selection for RFC Event 6
  [7:0] EV ro — [7:0] Read only selection value
    67=GPT3A_CMP (GPT3A compare event. Configured by GPT3:TAMR.TCACT)
0x11C RFCSEL7 reset 0x44 — Output Selection for RFC Event 7
  [7:0] EV ro — [7:0] Read only selection value
    68=GPT3B_CMP (GPT3B compare event. Configured by GPT3:TBMR.TCACT)
0x120 RFCSEL8 reset 0x77 — Output Selection for RFC Event 8
  [7:0] EV ro — [7:0] Read only selection value
    119=AON_RTC_UPD (RTC periodic event controlled by AON_RTC:CTL.RTC_UPD_EN)
0x124 RFCSEL9 reset 0x2 — Output Selection for RFC Event 9
  [7:0] EV — [7:0] Read/write selection value Writing any other value than values defined by a ENUM may result in undefined behavior.
    125=UART3_COMB (UART3 combined interrupt, interrupt flags are found here UART3:MIS); 124=UART2_COMB (UART2 combined interrupt, interrupt flags are found here UART2:MIS); 123=SPI3_COMB (SPI3 combined interrupt, interrupt flags are found here SPI3:MIS); 122=SPI2_COMB (SPI2 combined interrupt, interrupt flags are found here SPI2:MIS); 121=ALWAYS_ACTIVE (Always asserted); 115=AUX_ADC_IRQ (AUX ADC interrupt event, corresponds to AUX_EVCTL:EVTOMCUFLAGS.AUX_ADC_IRQ. Status flags are found here AUX_EVCTL:EVTOMCUFLAGS); 114=AUX_OBSMUX0 (Loopback of OBSMUX0 through AUX, corresponds to AUX_EVCTL:EVTOMCUFLAGS.MCU_OBSMUX0); 113=AUX_ADC_FIFO_ALMOST_FULL (AUX ADC FIFO watermark event, corresponds to AUX_EVCTL:EVTOMCUFLAGS.AUX_ADC_FIFO_ALMOST_FULL); 112=AUX_ADC_DONE (AUX ADC done, corresponds to AUX_EVCTL:EVTOMCUFLAGS.AUX_ADC_DONE); 111=AUX_SMPH_AUTOTAKE_DONE (Autotake event from AUX semaphore, configured by AUX_SMPH:AUTOTAKE); 110=AUX_TIMER1_EV (AUX timer 1 event, corresponds to AUX_EVCTL:EVTOMCUFLAGS.AUX_TIMER1_EV); 109=AUX_TIMER0_EV (AUX timer 0 event, corresponds to AUX_EVCTL:EVTOMCUFLAGS.AUX_TIMER0_EV); 108=AUX_TDC_DONE (AUX TDC measurement done event, corresponds to the flag AUX_EVCTL:EVTOMCUFLAGS.AUX_TDC_DONE and the AUX_TDC status AUX_TDC:STAT.DONE); 107=AUX_COMPB (AUX Compare B event, corresponds to AUX_EVCTL:EVTOMCUFLAGS.AUX_COMPB); 106=AUX_COMPA (AUX Compare A event, corresponds to AUX_EVCTL:EVTOMCUFLAGS.AUX_COMPA); 105=AUX_AON_WU_EV (AON wakeup event, the corresponding flag is here AUX_EVCTL:EVTOMCUFLAGS.AUX_WU_EV); 101=SWEV1 (Software event 1, triggered by SWEV.SWEV1); 100=SWEV0 (Software event 0, triggered by SWEV.SWEV0); 93=CRYPTO_RESULT_AVAIL_IRQ (CRYPTO result available interupt event, the corresponding flag is found here CRYPTO:IRQSTAT.RESULT_AVAIL. Controlled by CRYPTO:IRQSTAT.RESULT_AVAIL); 60=AUX_TIMER2_PULSE (AUX Timer2 pulse, corresponding to flag AUX_EVCTL:EVTOMCUFLAGS.AUX_TIMER2_PULSE); {v}=AUX_TIMER2_EV{v-56} (AUX Timer2 event {v-56}, corresponding to flag AUX_EVCTL:EVTOMCUFLAGS.AUX_TIMER2_EV{v-56}) (v=56..59); 39=DMA_DONE_COMB (Combined DMA done, corresponding flags are here UDMA0:REQDONE); 37=UART1_COMB (UART1 combined interrupt, interrupt flags are found here UART1:MIS); 36=UART0_COMB (UART0 combined interrupt, interrupt flags are found here UART0:MIS); 35=SPI1_COMB (SPI1 combined interrupt, interrupt flags are found here SPI1:MIS); 34=SPI0_COMB (SPI0 combined interrupt, interrupt flags are found here SPI0:MIS); 24=WDT_IRQ (Watchdog interrupt event, controlled by WDT:CTL.INTEN); 10=AON_AUX_SWEV0 (AUX Software event 0, AUX_EVCTL:SWEVSET.SWEV0); 8=I2S_IRQ (Interrupt event from I2S); 2=AON_PROG1 (AON programmable event 1. Event selected by AON_EVENT MCU event selector, AON_EVENT:EVTOMCUSEL.AON_PROG1_EV); 1=AON_PROG0 (AON programmable event 0. Event selected by AON_EVENT MCU event selector, AON_EVENT:EVTOMCUSEL.AON_PROG0_EV); 0=NONE (Always inactive)
0x200 GPT0ACAPTSEL reset 0x55 — Output Selection for GPT0 0
  [7:0] EV — [7:0] Read/write selection value Writing any other value than values defined by a ENUM may result in undefined behavior.
    126=I2C1_IRQ (Interrupt event from I2C1); 125=UART3_COMB (UART3 combined interrupt, interrupt flags are found here UART3:MIS); 124=UART2_COMB (UART2 combined interrupt, interrupt flags are found here UART2:MIS); 123=SPI3_COMB (SPI3 combined interrupt, interrupt flags are found here SPI3:MIS); 122=SPI2_COMB (SPI2 combined interrupt, interrupt flags are found here SPI2:MIS); 121=ALWAYS_ACTIVE (Always asserted); 119=AON_RTC_UPD (RTC periodic event controlled by AON_RTC:CTL.RTC_UPD_EN); 115=AUX_ADC_IRQ (AUX ADC interrupt event, corresponds to AUX_EVCTL:EVTOMCUFLAGS.AUX_ADC_IRQ. Status flags are found here AUX_EVCTL:EVTOMCUFLAGS); 114=AUX_OBSMUX0 (Loopback of OBSMUX0 through AUX, corresponds to AUX_EVCTL:EVTOMCUFLAGS.MCU_OBSMUX0); 113=AUX_ADC_FIFO_ALMOST_FULL (AUX ADC FIFO watermark event, corresponds to AUX_EVCTL:EVTOMCUFLAGS.AUX_ADC_FIFO_ALMOST_FULL); 112=AUX_ADC_DONE (AUX ADC done, corresponds to AUX_EVCTL:EVTOMCUFLAGS.AUX_ADC_DONE); 111=AUX_SMPH_AUTOTAKE_DONE (Autotake event from AUX semaphore, configured by AUX_SMPH:AUTOTAKE); 110=AUX_TIMER1_EV (AUX timer 1 event, corresponds to AUX_EVCTL:EVTOMCUFLAGS.AUX_TIMER1_EV); 109=AUX_TIMER0_EV (AUX timer 0 event, corresponds to AUX_EVCTL:EVTOMCUFLAGS.AUX_TIMER0_EV); 108=AUX_TDC_DONE (AUX TDC measurement done event, corresponds to the flag AUX_EVCTL:EVTOMCUFLAGS.AUX_TDC_DONE and the AUX_TDC status AUX_TDC:STAT.DONE); 107=AUX_COMPB (AUX Compare B event, corresponds to AUX_EVCTL:EVTOMCUFLAGS.AUX_COMPB); 106=AUX_COMPA (AUX Compare A event, corresponds to AUX_EVCTL:EVTOMCUFLAGS.AUX_COMPA); 105=AUX_AON_WU_EV (AON wakeup event, the corresponding flag is here AUX_EVCTL:EVTOMCUFLAGS.AUX_WU_EV); 86=PORT_EVENT1 (Port capture event from IOC, configured by IOC:IOCFGn.PORT_ID. Events on ports configured with ENUM PORT_EVENT1 wil be routed here.); 85=PORT_EVENT0 (Port capture event from IOC, configured by IOC:IOCFGn.PORT_ID. Events on ports configured with ENUM PORT_EVENT0 wil be routed here.); 68=GPT3B_CMP (GPT3B compare event. Configured by GPT3:TBMR.TCACT); 67=GPT3A_CMP (GPT3A compare event. Configured by GPT3:TAMR.TCACT); 66=GPT2B_CMP (GPT2B compare event. Configured by GPT2:TBMR.TCACT); 65=GPT2A_CMP (GPT2A compare event. Configured by GPT2:TAMR.TCACT); 64=GPT1B_CMP (GPT1B compare event. Configured by GPT1:TBMR.TCACT); 63=GPT1A_CMP (GPT1A compare event. Configured by GPT1:TAMR.TCACT); 62=GPT0B_CMP (GPT0B compare event. Configured by GPT0:TBMR.TCACT); 61=GPT0A_CMP (GPT0A compare event. Configured by GPT0:TAMR.TCACT); 60=AUX_TIMER2_PULSE (AUX Timer2 pulse, corresponding to flag AUX_EVCTL:EVTOMCUFLAGS.AUX_TIMER2_PULSE); {v}=AUX_TIMER2_EV{v-56} (AUX Timer2 event {v-56}, corresponding to flag AUX_EVCTL:EVTOMCUFLAGS.AUX_TIMER2_EV{v-56}) (v=56..59); 37=UART1_COMB (UART1 combined interrupt, interrupt flags are found here UART1:MIS); 36=UART0_COMB (UART0 combined interrupt, interrupt flags are found here UART0:MIS); 35=SPI1_COMB (SPI1 combined interrupt, interrupt flags are found here SPI1:MIS); 34=SPI0_COMB (SPI0 combined interrupt, interrupt flags are found here SPI0:MIS); 30=RFC_CPE_1 (Combined Interrupt for CPE Generated events. Corresponding flags are here RFC_DBELL:RFCPEIFG. Only interrupts selected with CPE1 in RFC_DBELL:RFCPEIFG can trigger a RFC_CPE_1 event); 27=RFC_CPE_0 (Combined Interrupt for CPE Generated events. Corresponding flags are here RFC_DBELL:RFCPEIFG. Only interrupts selected with CPE0 in RFC_DBELL:RFCPEIFG can trigger a RFC_CPE_0 event); 26=RFC_HW_COMB (Combined RFC hardware interrupt, corresponding flag is here RFC_DBELL:RFHWIFG); 25=RFC_CMD_ACK (RFC Doorbell Command Acknowledgement Interrupt, equvialent to RFC_DBELL:RFACKIFG.ACKFLAG); 21=FLASH (FLASH controller error event, the status flags are FLASH:FEDACSTAT.FSM_DONE and FLASH:FEDACSTAT.RVF_INT); 11=AUX_COMB (AUX combined event, the corresponding flag register is here AUX_EVCTL:EVTOMCUFLAGS); 9=I2C_IRQ (Interrupt event from I2C); 7=AON_RTC_COMB (Event from AON_RTC, controlled by the AON_RTC:CTL.COMB_EV_MASK setting); 6=OSC_COMB (Combined event from Oscillator control); 5=BATMON_COMB (Combined event from battery monitor); 4=AON_GPIO_EDGE (Edge detect event from IOC. Configureded by the IOC:IOCFGn.EDGE_IRQ_EN and IOC:IOCFGn.EDGE_DET settings); 0=NONE (Always inactive)
0x204 GPT0BCAPTSEL reset 0x56 — Output Selection for GPT0 1
  fields as GPT0ACAPTSEL
0x300 GPT1ACAPTSEL reset 0x57 — Output Selection for GPT1 0
  [7:0] EV — [7:0] Read/write selection value Writing any other value than values defined by a ENUM may result in undefined behavior.
    126=I2C1_IRQ (Interrupt event from I2C1); 125=UART3_COMB (UART3 combined interrupt, interrupt flags are found here UART3:MIS); 124=UART2_COMB (UART2 combined interrupt, interrupt flags are found here UART2:MIS); 123=SPI3_COMB (SPI3 combined interrupt, interrupt flags are found here SPI3:MIS); 122=SPI2_COMB (SPI2 combined interrupt, interrupt flags are found here SPI2:MIS); 121=ALWAYS_ACTIVE (Always asserted); 119=AON_RTC_UPD (RTC periodic event controlled by AON_RTC:CTL.RTC_UPD_EN); 115=AUX_ADC_IRQ (AUX ADC interrupt event, corresponds to AUX_EVCTL:EVTOMCUFLAGS.AUX_ADC_IRQ. Status flags are found here AUX_EVCTL:EVTOMCUFLAGS); 114=AUX_OBSMUX0 (Loopback of OBSMUX0 through AUX, corresponds to AUX_EVCTL:EVTOMCUFLAGS.MCU_OBSMUX0); 113=AUX_ADC_FIFO_ALMOST_FULL (AUX ADC FIFO watermark event, corresponds to AUX_EVCTL:EVTOMCUFLAGS.AUX_ADC_FIFO_ALMOST_FULL); 112=AUX_ADC_DONE (AUX ADC done, corresponds to AUX_EVCTL:EVTOMCUFLAGS.AUX_ADC_DONE); 111=AUX_SMPH_AUTOTAKE_DONE (Autotake event from AUX semaphore, configured by AUX_SMPH:AUTOTAKE); 110=AUX_TIMER1_EV (AUX timer 1 event, corresponds to AUX_EVCTL:EVTOMCUFLAGS.AUX_TIMER1_EV); 109=AUX_TIMER0_EV (AUX timer 0 event, corresponds to AUX_EVCTL:EVTOMCUFLAGS.AUX_TIMER0_EV); 108=AUX_TDC_DONE (AUX TDC measurement done event, corresponds to the flag AUX_EVCTL:EVTOMCUFLAGS.AUX_TDC_DONE and the AUX_TDC status AUX_TDC:STAT.DONE); 107=AUX_COMPB (AUX Compare B event, corresponds to AUX_EVCTL:EVTOMCUFLAGS.AUX_COMPB); 106=AUX_COMPA (AUX Compare A event, corresponds to AUX_EVCTL:EVTOMCUFLAGS.AUX_COMPA); 105=AUX_AON_WU_EV (AON wakeup event, the corresponding flag is here AUX_EVCTL:EVTOMCUFLAGS.AUX_WU_EV); 88=PORT_EVENT3 (Port capture event from IOC, configured by IOC:IOCFGn.PORT_ID. Events on ports configured with ENUM PORT_EVENT3 wil be routed here.); 87=PORT_EVENT2 (Port capture event from IOC, configured by IOC:IOCFGn.PORT_ID. Events on ports configured with ENUM PORT_EVENT2 wil be routed here.); 68=GPT3B_CMP (GPT3B compare event. Configured by GPT3:TBMR.TCACT); 67=GPT3A_CMP (GPT3A compare event. Configured by GPT3:TAMR.TCACT); 66=GPT2B_CMP (GPT2B compare event. Configured by GPT2:TBMR.TCACT); 65=GPT2A_CMP (GPT2A compare event. Configured by GPT2:TAMR.TCACT); 64=GPT1B_CMP (GPT1B compare event. Configured by GPT1:TBMR.TCACT); 63=GPT1A_CMP (GPT1A compare event. Configured by GPT1:TAMR.TCACT); 62=GPT0B_CMP (GPT0B compare event. Configured by GPT0:TBMR.TCACT); 61=GPT0A_CMP (GPT0A compare event. Configured by GPT0:TAMR.TCACT); 60=AUX_TIMER2_PULSE (AUX Timer2 pulse, corresponding to flag AUX_EVCTL:EVTOMCUFLAGS.AUX_TIMER2_PULSE); {v}=AUX_TIMER2_EV{v-56} (AUX Timer2 event {v-56}, corresponding to flag AUX_EVCTL:EVTOMCUFLAGS.AUX_TIMER2_EV{v-56}) (v=56..59); 37=UART1_COMB (UART1 combined interrupt, interrupt flags are found here UART1:MIS); 36=UART0_COMB (UART0 combined interrupt, interrupt flags are found here UART0:MIS); 35=SPI1_COMB (SPI1 combined interrupt, interrupt flags are found here SPI1:MIS); 34=SPI0_COMB (SPI0 combined interrupt, interrupt flags are found here SPI0:MIS); 30=RFC_CPE_1 (Combined Interrupt for CPE Generated events. Corresponding flags are here RFC_DBELL:RFCPEIFG. Only interrupts selected with CPE1 in RFC_DBELL:RFCPEIFG can trigger a RFC_CPE_1 event); 27=RFC_CPE_0 (Combined Interrupt for CPE Generated events. Corresponding flags are here RFC_DBELL:RFCPEIFG. Only interrupts selected with CPE0 in RFC_DBELL:RFCPEIFG can trigger a RFC_CPE_0 event); 26=RFC_HW_COMB (Combined RFC hardware interrupt, corresponding flag is here RFC_DBELL:RFHWIFG); 25=RFC_CMD_ACK (RFC Doorbell Command Acknowledgement Interrupt, equvialent to RFC_DBELL:RFACKIFG.ACKFLAG); 21=FLASH (FLASH controller error event, the status flags are FLASH:FEDACSTAT.FSM_DONE and FLASH:FEDACSTAT.RVF_INT); 11=AUX_COMB (AUX combined event, the corresponding flag register is here AUX_EVCTL:EVTOMCUFLAGS); 9=I2C_IRQ (Interrupt event from I2C); 7=AON_RTC_COMB (Event from AON_RTC, controlled by the AON_RTC:CTL.COMB_EV_MASK setting); 6=OSC_COMB (Combined event from Oscillator control); 5=BATMON_COMB (Combined event from battery monitor); 4=AON_GPIO_EDGE (Edge detect event from IOC. Configureded by the IOC:IOCFGn.EDGE_IRQ_EN and IOC:IOCFGn.EDGE_DET settings); 0=NONE (Always inactive)
0x304 GPT1BCAPTSEL reset 0x58 — Output Selection for GPT1 1
  fields as GPT1ACAPTSEL
0x400 GPT2ACAPTSEL reset 0x59 — Output Selection for GPT2 0
  [7:0] EV — [7:0] Read/write selection value Writing any other value than values defined by a ENUM may result in undefined behavior.
    126=I2C1_IRQ (Interrupt event from I2C1); 125=UART3_COMB (UART3 combined interrupt, interrupt flags are found here UART3:MIS); 124=UART2_COMB (UART2 combined interrupt, interrupt flags are found here UART2:MIS); 123=SPI3_COMB (SPI3 combined interrupt, interrupt flags are found here SPI3:MIS); 122=SPI2_COMB (SPI2 combined interrupt, interrupt flags are found here SPI2:MIS); 121=ALWAYS_ACTIVE (Always asserted); 119=AON_RTC_UPD (RTC periodic event controlled by AON_RTC:CTL.RTC_UPD_EN); 115=AUX_ADC_IRQ (AUX ADC interrupt event, corresponds to AUX_EVCTL:EVTOMCUFLAGS.AUX_ADC_IRQ. Status flags are found here AUX_EVCTL:EVTOMCUFLAGS); 114=AUX_OBSMUX0 (Loopback of OBSMUX0 through AUX, corresponds to AUX_EVCTL:EVTOMCUFLAGS.MCU_OBSMUX0); 113=AUX_ADC_FIFO_ALMOST_FULL (AUX ADC FIFO watermark event, corresponds to AUX_EVCTL:EVTOMCUFLAGS.AUX_ADC_FIFO_ALMOST_FULL); 112=AUX_ADC_DONE (AUX ADC done, corresponds to AUX_EVCTL:EVTOMCUFLAGS.AUX_ADC_DONE); 111=AUX_SMPH_AUTOTAKE_DONE (Autotake event from AUX semaphore, configured by AUX_SMPH:AUTOTAKE); 110=AUX_TIMER1_EV (AUX timer 1 event, corresponds to AUX_EVCTL:EVTOMCUFLAGS.AUX_TIMER1_EV); 109=AUX_TIMER0_EV (AUX timer 0 event, corresponds to AUX_EVCTL:EVTOMCUFLAGS.AUX_TIMER0_EV); 108=AUX_TDC_DONE (AUX TDC measurement done event, corresponds to the flag AUX_EVCTL:EVTOMCUFLAGS.AUX_TDC_DONE and the AUX_TDC status AUX_TDC:STAT.DONE); 107=AUX_COMPB (AUX Compare B event, corresponds to AUX_EVCTL:EVTOMCUFLAGS.AUX_COMPB); 106=AUX_COMPA (AUX Compare A event, corresponds to AUX_EVCTL:EVTOMCUFLAGS.AUX_COMPA); 105=AUX_AON_WU_EV (AON wakeup event, the corresponding flag is here AUX_EVCTL:EVTOMCUFLAGS.AUX_WU_EV); 90=PORT_EVENT5 (Port capture event from IOC, configured by IOC:IOCFGn.PORT_ID. Events on ports configured with ENUM PORT_EVENT4 wil be routed here.); 89=PORT_EVENT4 (Port capture event from IOC, configured by IOC:IOCFGn.PORT_ID. Events on ports configured with ENUM PORT_EVENT4 wil be routed here.); 68=GPT3B_CMP (GPT3B compare event. Configured by GPT3:TBMR.TCACT); 67=GPT3A_CMP (GPT3A compare event. Configured by GPT3:TAMR.TCACT); 66=GPT2B_CMP (GPT2B compare event. Configured by GPT2:TBMR.TCACT); 65=GPT2A_CMP (GPT2A compare event. Configured by GPT2:TAMR.TCACT); 64=GPT1B_CMP (GPT1B compare event. Configured by GPT1:TBMR.TCACT); 63=GPT1A_CMP (GPT1A compare event. Configured by GPT1:TAMR.TCACT); 62=GPT0B_CMP (GPT0B compare event. Configured by GPT0:TBMR.TCACT); 61=GPT0A_CMP (GPT0A compare event. Configured by GPT0:TAMR.TCACT); 60=AUX_TIMER2_PULSE (AUX Timer2 pulse, corresponding to flag AUX_EVCTL:EVTOMCUFLAGS.AUX_TIMER2_PULSE); {v}=AUX_TIMER2_EV{v-56} (AUX Timer2 event {v-56}, corresponding to flag AUX_EVCTL:EVTOMCUFLAGS.AUX_TIMER2_EV{v-56}) (v=56..59); 37=UART1_COMB (UART1 combined interrupt, interrupt flags are found here UART1:MIS); 36=UART0_COMB (UART0 combined interrupt, interrupt flags are found here UART0:MIS); 35=SPI1_COMB (SPI1 combined interrupt, interrupt flags are found here SPI1:MIS); 34=SPI0_COMB (SPI0 combined interrupt, interrupt flags are found here SPI0:MIS); 30=RFC_CPE_1 (Combined Interrupt for CPE Generated events. Corresponding flags are here RFC_DBELL:RFCPEIFG. Only interrupts selected with CPE1 in RFC_DBELL:RFCPEIFG can trigger a RFC_CPE_1 event); 27=RFC_CPE_0 (Combined Interrupt for CPE Generated events. Corresponding flags are here RFC_DBELL:RFCPEIFG. Only interrupts selected with CPE0 in RFC_DBELL:RFCPEIFG can trigger a RFC_CPE_0 event); 26=RFC_HW_COMB (Combined RFC hardware interrupt, corresponding flag is here RFC_DBELL:RFHWIFG); 25=RFC_CMD_ACK (RFC Doorbell Command Acknowledgement Interrupt, equvialent to RFC_DBELL:RFACKIFG.ACKFLAG); 21=FLASH (FLASH controller error event, the status flags are FLASH:FEDACSTAT.FSM_DONE and FLASH:FEDACSTAT.RVF_INT); 11=AUX_COMB (AUX combined event, the corresponding flag register is here AUX_EVCTL:EVTOMCUFLAGS); 9=I2C_IRQ (Interrupt event from I2C); 7=AON_RTC_COMB (Event from AON_RTC, controlled by the AON_RTC:CTL.COMB_EV_MASK setting); 6=OSC_COMB (Combined event from Oscillator control); 5=BATMON_COMB (Combined event from battery monitor); 4=AON_GPIO_EDGE (Edge detect event from IOC. Configureded by the IOC:IOCFGn.EDGE_IRQ_EN and IOC:IOCFGn.EDGE_DET settings); 0=NONE (Always inactive)
0x404 GPT2BCAPTSEL reset 0x5A — Output Selection for GPT2 1
  fields as GPT2ACAPTSEL
0x500 UDMACH0SSEL — Software should not rely on the value of a reserved. Writing any other value than the reset value may result in undefined behavior.
  [31:0] EV ro — [31:0] Software should not rely on the value of a reserved. Writing any other value than the reset value may result in undefined behavior.
    0=NONE (Always inactive)
0x504 UDMACH0BSEL — Software should not rely on the value of a reserved. Writing any other value than the reset value may result in undefined behavior.
  fields as UDMACH0SSEL
0x508 UDMACH1SSEL reset 0x31 — Output Selection for DMA Channel 1 SREQ
  [7:0] EV ro — [7:0] Read only selection value
    49=UART0_RX_DMASREQ (UART0 RX DMA single request, controlled by UART0:DMACTL.RXDMAE)
0x50C UDMACH1BSEL reset 0x30 — Output Selection for DMA Channel 1 REQ
  [7:0] EV ro — [7:0] Read only selection value
    48=UART0_RX_DMABREQ (UART0 RX DMA burst request, controlled by UART0:DMACTL.RXDMAE)
0x510 UDMACH2SSEL reset 0x33 — Output Selection for DMA Channel 2 SREQ
  [7:0] EV ro — [7:0] Read only selection value
    51=UART0_TX_DMASREQ (UART0 TX DMA single request, controlled by UART0:DMACTL.TXDMAE)
0x514 UDMACH2BSEL reset 0x32 — Output Selection for DMA Channel 2 REQ
  [7:0] EV ro — [7:0] Read only selection value
    50=UART0_TX_DMABREQ (UART0 TX DMA burst request, controlled by UART0:DMACTL.TXDMAE)
0x518 UDMACH3SSEL reset 0x29 — Output Selection for DMA Channel 3 SREQ
  [7:0] EV ro — [7:0] Read only selection value
    41=SPI0_RX_DMASREQ (SPI0 RX DMA single request, controlled by SPI0:DMACR.RXDMAE)
0x51C UDMACH3BSEL reset 0x28 — Output Selection for DMA Channel 3 REQ
  [7:0] EV ro — [7:0] Read only selection value
    40=SPI0_RX_DMABREQ (SPI0 RX DMA burst request , controlled by SPI0:DMACR.RXDMAE)
0x520 UDMACH4SSEL reset 0x2B — Output Selection for DMA Channel 4 SREQ
  [7:0] EV ro — [7:0] Read only selection value
    43=SPI0_TX_DMASREQ (SPI0 TX DMA single request, controlled by SPI0:DMACR.TXDMAE)
0x524 UDMACH4BSEL reset 0x2A — Output Selection for DMA Channel 4 REQ
  [7:0] EV ro — [7:0] Read only selection value
    42=SPI0_TX_DMABREQ (SPI0 TX DMA burst request , controlled by SPI0:DMACR.TXDMAE)
0x528 UDMACH5SSEL reset 0x35 — Output Selection for DMA Channel 5 SREQ
  [7:0] EV ro — [7:0] Read only selection value
    53=UART1_RX_DMASREQ (UART1 RX DMA single request, controlled by UART1:DMACTL.RXDMAE)
