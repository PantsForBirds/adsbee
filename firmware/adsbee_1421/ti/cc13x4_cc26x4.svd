# CC1314R10 register map
File version: 1.0
SimpleLink(TM) SUB-1 GHz(R) low energy CC1314R10 wireless MCU
CPU: CM33 1.0, other endian, MPU, FPU, 3 interrupt priority bits
Registers are 32-bit, read-write, reset 0x0 unless marked. A register's access mark holds for its fields unless they carry their own. Offsets are from the block's base; lines under a group give offsets from that group; [hi:lo] are bit positions; {n}, {i} and the like mark numbered series; 'fields as' and 'values as' point back to an identical list; <NAME> marks a mode.

## Memory map
0x40000000 SPI0 size 0x1000 — Serial Peripheral Interface (SPI) with master and slave capabilities
0x40001000 UART0 size 0x1000 — Universal Asynchronous Receiver/Transmitter (UART) interface
0x40002000 I2C0 size 0x1000 — I2CMaster/Slave Serial Controler
0x40008000 SPI1 size 0x1000 — Serial Peripheral Interface (SPI) with master and slave capabilities
0x40009000 SPI2 size 0x1000 — Serial Peripheral Interface (SPI) with master and slave capabilities
0x4000A000 SPI3 size 0x1000 — Serial Peripheral Interface (SPI) with master and slave capabilities
0x4000B000 UART1 size 0x1000 — Universal Asynchronous Receiver/Transmitter (UART) interface
0x4000C000 UART2 size 0x1000 — Universal Asynchronous Receiver/Transmitter (UART) interface
0x4000D000 UART3 size 0x1000 — Universal Asynchronous Receiver/Transmitter (UART) interface
0x40010000 GPT0 size 0x1000 — General Purpose Timer.
0x40011000 GPT1 size 0x1000 — General Purpose Timer.
0x40012000 GPT2 size 0x1000 — General Purpose Timer.
0x40013000 GPT3 size 0x1000 — General Purpose Timer.
0x40020000 UDMA0 size 0x1000 — ARM Micro Direct Memory Access Controller
0x40021000 I2S0 size 0x1000 — I2S Audio DMA module supporting formats I2S, LJF, RJF and DSP
0x40022000 GPIO size 0x400 — MCU GPIO - I/F for controlling and reading IO status and IO event status
0x4002A000 I2C1 size 0x1000 — I2CMaster/Slave Serial Controler
0x40034000 VIMS size 0x400 — Versatile Instruction Memory System Controls memory access to the Flash and encapsulates the following instruction memories: - Boot ROM - Cache / GPRAM
0x40040000 RFC_PWR size 0x4 — RF core power management This module contains clock control for all RF core sub-modules.
0x40041000 RFC_DBELL size 0x40 — RF core doorbell The doorbell module is the main user interface to the radio sub-system. It contains the registers used for both submitting commands to the radio, and for configuring radio interrupts from the RF core.
0x40043000 RFC_RAT size 0x100 — RF core radio timer
0x40080000 WDT size 0x1000 — Watchdog Timer
0x40081000 IOC size 0x1000 — IO Controller (IOC) - configures all the DIOs and resides in the MCU domain. Note: Performing a write operation that includes IOC.IOCFGn.PORT_ID, may cause glitches on the IO. This can happen even if the write operation does not actually change the PORT_ID field (i.e. the write operation writes the same value as it already held) . This happens because the write operation triggers activities in the IOC that may, in some cases, cause glitches. To avoid glitches refrain from writing to this field other than when needed to actually change the PORT_ID value. Note that it is possible to write to parts of the IOCFGn register without writing to PORT_ID by using byte oriented writes to the parts of the register that do not contain PORT_ID
0x40083000 EVENT size 0x1000 — Event Fabric Component Definition
0x40084000 SMPH size 0x1000 — MCU Semaphore Module This module provides 32 binary semaphores. The state of a binary semaphore is either taken or available. A semaphore does not implement any ownership attribute. Still, a semaphore can be used to handle mutual exclusion scenarios.
0x40093000 AON_EVENT size 0x400 — This module configures the event fabric located in the AON domain. Note: This module is only supporting 32 bit ReadWrite access from MCU
0x40094000 AON_IOC size 0x400 — Always On (AON) IO Controller - controls IO operation when the MCU IO Controller (IOC) is powered off and resides in the AON domain. Note: This module only supports 32 bit Read/Write access from MCU.
0x40095000 AON_BATMON size 0x400 — Always On (AON) Battery And Temperature MONitor (BATMON) residing in the AON domain Note: This module only supports 32 bit Read/Write access from MCU.
0x400C1000 AUX_SPIM size 0x1000 — The AUX Serial Peripheral Interface Master (AUX_SPIM) enables AUX_SCE with power-efficient SPI communication. It is not possible to write a register while SPI transmission occurs. An attempt to do so will stall the bus until transmission is complete. Read of RX8.DATA or RX16.DATA stalls the bus until LSB has been captured. Read of SCLKIDLE.STAT or DATAIDLE.STAT stalls the bus until condition described is met. Other read operations do not stall the bus. AUX_SCE becomes clock gated if it encounters a bus stall. This is useful as AUX_SCE can write TX8.DATA and then read RX8.DATA immediately to read a SPI slave. In such case there is no need for software to wait or to poll registers. AUX_SYSIF:PEROPRATE.SPIM_OP_RATE selects the peripheral clock frequency which is used to derive the SCLK frequency. AUX_SCE must set AUX_SYSIF:PEROPRATE.SPIM_OP_RATE to SCE_RATE to access and use AUX_SPIM. System CPU must set AUX_SYSIF:PEROPRATE.SPIM_OP_RATE to BUS_RATE to access and use AUX_SPIM. Failure to do so can result in incorrect SPI transmission.
0x400C2000 AUX_MAC size 0x1000 — The AUX Multiply-Accumulate (AUX_MAC) peripheral enables AUX_SCE with power-efficient and flexible mathematical operations: - 2's complement signed and unsigned sequential multiplication (MUL) with optional accumulation of the result (MAC). - 16 or 32-bit 2's complement signed and unsigned addition of configurable term and accumulator (ADD). - Results of ADD, MUL and MAC operations are always stored in the accumulator (ACC). Software can easily: - Access arbitrary 16-bit slice of the 40-bit accumulator. - Find the number of leading zero or sign bits. - Perform shift operations on the accumulator. AUX_SCE must set AUX_SYSIF:PEROPRATE.MAC_OP_RATE to SCE_RATE to access and use AUX_MAC. System CPU must set AUX_SYSIF:PEROPRATE.MAC_OP_RATE to BUS_RATE to access and use AUX_MAC. This guarantees constant execution times for ADD, MUL, and MAC operations. The ADD operation requires a single peripheral clock cycle to finish. MUL and MAC operations require four peripheral clock periods to finish. An unfinished ADD, MUL, or MAC operation stalls register access to this peripheral. AUX_SCE becomes clock gated if it encounters a bus stall. Software can use this to reduce power consumption during back to back accesses. Only full word access is supported by the peripheral. An attempt to write a single byte will have no effect.
0x400C3000 AUX_TIMER2 size 0x1000 — AUX Timer2 (AUX_TIMER2) offers flexible: - generation of waveforms and events. - capture of signal period and duty cycle. - generation of single clock pulse. It consists of a: - 16-bit counter. - 4 capture compare channels. - 4 event outputs, which are mapped to AUX event bus, see EVCTL. Each channel subscribes to the asynchronous AUX event bus. They can control one or more event outputs in both capture and compare modes. AUX_SYSIF:TIMER2CLKCTL.SRC selects clock source for the timer.
0x400C4000 AUX_TDC size 0x1000 — AUX Time To Digital Converter (AUX_TDC) is used to measure the time between two events with high resolution. AUX_TDC consists of a state machine that operates at AUX bus rate and an asynchronous fast-counter which is clocked by the TDC clock. DDI_0_OSC:CTL0.ACLK_TDC_SRC_SEL configures TDC clock source. The fast-counter counts on both edges of the TDC clock to double the resolution. See the Technical Reference Manual for event timing requirements.
0x400C5000 AUX_EVCTL size 0x1000 — AUX Event Controller (AUX_EVCTL) assembles events originating from: - AUX submodules, including ADC and comparators. - AUXIO. - EVENT. - AON_PMCTL. - AON_RTC. - AON_BATMON. into two 64-bit event buses. One is synchronized to the AUX clock and one is left unsynchronized. The subscribers to the synchronous event bus are AUX_TIMER01, AUX_SCE and AUX_EVCTL. The subscribers to the asynchronous event bus are AUX_TIMER2, AUX_ANAIF, AUX_TDC and AUX_SYSIF. AUX_EVCTL uses the synchronous event bus to generate events to AON_EVENT and EVENT, as well as to AUX_SCE. AUX_SCE can poll event status registers and combine certain instructions like WEV0, WEV1 with one or two configurable events. The latter saves power when execution must stall until a condition is met.
0x400C7000 AUX_TIMER01 size 0x1000 — AUX Timer 0 and AUX Timer 1 (AUX_TIMER01) are two 16-bit timers capable of generating one event each: - AUX_EVCTL:EVSTAT3.AUX_TIMER0_EV. - AUX_EVCTL:EVSTAT3.AUX_TIMER1_EV. The events are described in T0TARGET and T1TARGET. Subscribers to the AUX event bus can use these events to sequence and trigger actions. AUX_SYSIF:PEROPRATE.TIMER01_OP_RATE sets the peripheral clock frequency used by the prescaler, timer, and event logic to SCE or AUX bus rate. To use AUX_TIMER01: - AUX_SCE must set AUX_SYSIF:PEROPRATE.TIMER01_OP_RATE to SCE_RATE. - System CPU must set AUX_SYSIF:PEROPRATE.TIMER01_OP_RATE to BUS_RATE. - The timers must only subscribe to events updated at the peripheral clock frequency or lower. Unexpected execution behavior can result if software does not obey these rules.
0x400C8000 AUX_SMPH size 0x1000 — AUX Semaphore (AUX_SMPH) provides hardware means to share modules in AUX safely between CPUs based on resource ownership. AUX_SMPH operates at AUX bus rate.
0x400C9000 AUX_ANAIF size 0x1000 — AUX Analog Interface (AUX_ANAIF) encapsulates direct data and control interfaces between AUX digital and AUX analog circuits. It lets UDMA0, and system CPU: -Trigger ADC sample and conversion process. - Write ADC samples to FIFO. - Charge analog nodes by the use of the analog ISRC module. See ADI_4_AUX:ISRC and ADI_4_AUX:COMP.COMPA_REF_CURR_EN for further information. - Use the DAC to generate a programmable voltage on COMPB_REF, COMPA_REF, or COMPA_IN analog nodes. To use: - DAC : System CPU must set AUX_SYSIF:PEROPRATE.ANAIF_DAC_OP_RATE to BUS_RATE as long as DAC state machine generates the sample clock. See DACSMPLCTL.EN for further information.
0x400CB000 AUX_ADI4 size 0x200 — Configuration registers controlling analog peripherals of AUX. Registers Fields should be considered static unless otherwise noted (as dynamic)
0x400CC000 AUX_AIODIO0 size 0x1000 — AUX Analog Digital Input Output Controller (AUX_AIODIO) controls the general purpose input output pins of the AUX domain. These pins are referenced as AUXIO and can: - be connected to analog AUX modules, such as comparators and ADC. - be used by AUX_SCE. - connect to AUX_SPIM SCLK, MISO and MOSI signals. - connect to the asynchronous AUX event bus. Enabled digital inputs are synchronized at SCE clock rate. Note that the IO mapping in the AUX domain is different from the IO mapping in the MCU domain. This means that AUXIO[n] does not map to DIO[n]. AUXIO-DIO remapping is handled by Sensor Controller Studio.
0x400CD000 AUX_AIODIO1 size 0x1000 — AUX Analog Digital Input Output Controller (AUX_AIODIO) controls the general purpose input output pins of the AUX domain. These pins are referenced as AUXIO and can: - be connected to analog AUX modules, such as comparators and ADC. - be used by AUX_SCE. - connect to AUX_SPIM SCLK, MISO and MOSI signals. - connect to the asynchronous AUX event bus. Enabled digital inputs are synchronized at SCE clock rate. Note that the IO mapping in the AUX domain is different from the IO mapping in the MCU domain. This means that AUXIO[n] does not map to DIO[n]. AUXIO-DIO remapping is handled by Sensor Controller Studio.
0x400CE000 AUX_AIODIO2 size 0x1000 — AUX Analog Digital Input Output Controller (AUX_AIODIO) controls the general purpose input output pins of the AUX domain. These pins are referenced as AUXIO and can: - be connected to analog AUX modules, such as comparators and ADC. - be used by AUX_SCE. - connect to AUX_SPIM SCLK, MISO and MOSI signals. - connect to the asynchronous AUX event bus. Enabled digital inputs are synchronized at SCE clock rate. Note that the IO mapping in the AUX domain is different from the IO mapping in the MCU domain. This means that AUXIO[n] does not map to DIO[n]. AUXIO-DIO remapping is handled by Sensor Controller Studio.
0x400CF000 AUX_AIODIO3 size 0x1000 — AUX Analog Digital Input Output Controller (AUX_AIODIO) controls the general purpose input output pins of the AUX domain. These pins are referenced as AUXIO and can: - be connected to analog AUX modules, such as comparators and ADC. - be used by AUX_SCE. - connect to AUX_SPIM SCLK, MISO and MOSI signals. - connect to the asynchronous AUX event bus. Enabled digital inputs are synchronized at SCE clock rate. Note that the IO mapping in the AUX domain is different from the IO mapping in the MCU domain. This means that AUXIO[n] does not map to DIO[n]. AUXIO-DIO remapping is handled by Sensor Controller Studio.
0x50000800 FCFG1 size 0x800 — Factory configuration area (FCFG1)
0x58024000 CRYPTO size 0x800 — DMA Crypto Core is a low power low gate count crypto core with DMA capability and local key storage.
0x58025000 PKA size 0x1000 — Integrated module which combines the Public Key Acceleration module, optional True Random Gnerator, optional interrupt controller and a standard bus interface
0x58027000 PKA_INT size 0x1000 — Integrated module which includes the PKA K
0x58028000 TRNG size 0x2000 — True Random Number Generator
0x58030000 FLASH size 0x2000 — Thor1M Flash sub-system registers, includes the NoWrapper Flash Memory Controller (NW), flash read path, and an integrated Efuse controller and EFUSEROM.
0x58032000 NVMNW size 0x1000
0x58035000 SRAM_MMR size 0x5000 — General Purpose RAM
0x58082000 PRCM size 0x1000 — Power, Reset and Clock Management
0x58090000 AON_PMCTL size 0x1000 — This component control the Power Management controller residing in the AON domain. Note: This module is only supporting 32 bit Read Write access from MCU
0x58092000 AON_RTC size 0x400 — This component control the Real Time Clock residing in AON Note: This module is only supporting 32 bit ReadWrite access.
0x580C6000 AUX_SYSIF size 0x1000 — AUX System Interface (AUX_SYSIF) is responsible for: - system resource requests, such as power supply, clock and, wakeup requests. - configuration of AUX peripheral operational rates for AUX_SPIM, AUX_MAC, AUX_ANAIF DAC state machine and AUX_TIMER01. - configuration of event synchronization rate for AUX_EVCTL:EVSTAT2 and AUX_EVCTL:EVSTAT3. - configuration of AUX_SCE wakeup vectors that trigger AUX_SCE execution from sleep. Peripheral operational rate for AUX modules mentioned above can either be: - SCE rate, which is configured in AON_PMCTL:AUXSCECLK. - AUX bus rate, which equals SCE rate or SCLK_HF divided by two when MCU domain is active or AUX operational mode is active. AUX_SYSIF also interfaces AON_RTC and AON_BATMON to enable read access to data and sub-second increment control of AON_RTC.
0x580CA000 AUX_DDI0_OSC size 0x1000 — This is the DDI for the digital block that controls all the analog clock oscillators (OSC_DIG) and performs qualification of the clocks generated.
0x580E1000 AUX_SCE size 0x1000 — AUX Sensor Control Engine (AUX_SCE) is a RISC-style microprocessor with separate fetch and execution cycles. It is optimized for low power and simple operations. AUX_SCE code and data segments are stored in AUX_RAM. AON_PMCTL:AUXSCECLK sets the operational frequency.
0xE0000000 CPU_ITM size 0x1000 — Cortex-M's Instrumentation Trace Macrocell (ITM)
0xE0001000 CPU_DWT size 0x1000 — Cortex-M's Data watchpoint and Trace (DWT)
0xE0002000 CPU_FPB size 0x1000 — Cortex-M's Flash Patch and Breakpoint (FPB)
0xE000E000 CPU_ICB size 0xC — Cortex-M's Implementation Control Block (ICB)
0xE000E010 CPU_SYSTICK size 0x10 — Cortex-M's System Timer (SYSTICK)
0xE000E100 CPU_NVIC size 0xC00 — Cortex-M's Nested Vectored Interrupt Controller (NVIC)
0xE000ED00 CPU_SCB size 0x1000 — Cortex-M's System Control Block (SCB)
0xE000ED90 CPU_MPU size 0x38 — Cortex-M's Memory Protection Unit (MPU)
0xE000EDD0 CPU_SAU size 0x1C — Cortex-M's Security Attribution Unit (SAU)
0xE000EDE0 CPU_DCB size 0x1C — Cortex-M's Debug Control Block
0xE000EF00 CPU_SIG size 0x4 — Cortex-M's Software Interrupt Generator (SIG)
0xE000EF30 CPU_FPU size 0x18 — Cortex-M's Floating Point Unit (FPU)
0xE0040000 CPU_TPIU size 0x1000 — Cortex-M's Trace Port Interface Unit (TPIU)
